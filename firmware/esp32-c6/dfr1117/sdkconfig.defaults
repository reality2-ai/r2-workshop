## firmware/esp32-c6/dfr1117/sdkconfig.defaults
```kconfig
# sdkconfig.defaults — applied on top of ESP-IDF defaults at build time.
# Tuned for the DFRobot Beetle ESP32-C6 (DFR1117). RISC-V, single-core,
# no PSRAM, 4 MB flash (ESP32-C6-FH4). See docs/datasheets/DFR1117-*.

CONFIG_IDF_TARGET="esp32c6"

# Generous main-task stack for higher-level Rust code (logging,
# allocations, BLE/WiFi/SPI work).
CONFIG_ESP_MAIN_TASK_STACK_SIZE=16000

# DFR1117 is ESP32-C6-FH4: 4 MB flash, no PSRAM.
CONFIG_ESPTOOLPY_FLASHSIZE_4MB=y
# (No CONFIG_SPIRAM — the C6 / DFR1117 has no PSRAM.)

# Watchdog defaults are 5 s on the main task — fine for the smoke test.

# ─── Console routing ──────────────────────────────────────────────────────
# The ESP32-C6 has a native USB-Serial-JTAG; route `log::info!` there so the
# same USB-C cable used for flashing also carries the UART monitor.
CONFIG_ESP_CONSOLE_USB_SERIAL_JTAG=y

# ─── OTA / partition table ────────────────────────────────────────────────
# Custom two-OTA-slot layout — see partitions.csv in this directory (sized
# to fit the 4 MB flash). build.rs copies partitions.csv into esp-idf-sys's
# CMake build dir each cycle so this relative path resolves there.
#
# First build of a fresh checkout uses the ESP-IDF default table because the
# OUT dir doesn't exist yet when build.rs first runs. Run
# `tools/setup-firmware.sh` before the first cargo invocation, or rebuild
# once. Second build onwards picks up the custom layout. The FIRST install
# must be a full USB flash (espflash flash) to write the partition table +
# both OTA slots; OTA updates only work after that initial flash.
CONFIG_PARTITION_TABLE_CUSTOM=y
CONFIG_PARTITION_TABLE_CUSTOM_FILENAME="partitions.csv"
CONFIG_BOOTLOADER_APP_ROLLBACK_ENABLE=y

# ─── Bluetooth LE / NimBLE (Phase 6) ──────────────────────────────────────
# Required for r2-esp::beacon (R2-BEACON advertise+scan) and r2-esp::l2cap
# (CoC server on PSM 0xD2). esp32-nimble only generates its `sys::*`
# bindings against these symbols when NimBLE is the selected host stack.
# The ESP32-C6 has BLE 5.0; NimBLE is supported on the C6 in ESP-IDF 5.2.
CONFIG_BT_ENABLED=y
CONFIG_BT_NIMBLE_ENABLED=y
CONFIG_BT_BLUEDROID_ENABLED=n
CONFIG_BT_NIMBLE_MAX_CONNECTIONS=3
CONFIG_BT_NIMBLE_ROLE_CENTRAL=y
CONFIG_BT_NIMBLE_ROLE_PERIPHERAL=y
CONFIG_BT_NIMBLE_ROLE_OBSERVER=y
CONFIG_BT_NIMBLE_ROLE_BROADCASTER=y
CONFIG_BT_NIMBLE_L2CAP_COC_MAX_NUM=3
CONFIG_BT_NIMBLE_ATT_PREFERRED_MTU=251

# ── FATFS long filenames (SPEC-R2-WORKSHOP-CAPTURE §4) ─────────────────
# The capture filename convention is <ts16>-<name>.csv which exceeds 8.3.
CONFIG_FATFS_LFN_HEAP=y
CONFIG_FATFS_MAX_LFN=255
```
